## CMakeLists.txt
```
cmake_minimum_required(VERSION 3.20.0)
find_package(Zephyr REQUIRED HINTS $ENV{ZEPHYR_BASE})
project(test-bt)
FILE(GLOB app_sources src/*.c)
target_sources(app PRIVATE ${app_sources})
target_include_directories(app PRIVATE ${CMAKE_CURRENT_SOURCE_DIR}/include)
target_link_libraries(app PRIVATE ${CMAKE_CURRENT_SOURCE_DIR}/lib/hal_02_seed_studio_xiao_nrf52840_sense.c.obj)
```

## sample.yaml
```
sample:
  name: OTAinfo accelerometer and gyrometer sensor
```

## prj.conf
```kconfig
CONFIG_STDOUT_CONSOLE=y
CONFIG_I2C=y
CONFIG_SPI=y
CONFIG_SENSOR=y
CONFIG_TEMP_NRF5=y
CONFIG_LSM6DSL_TRIGGER_GLOBAL_THREAD=y
CONFIG_CBPRINTF_FP_SUPPORT=y
CONFIG_BT=y
CONFIG_BT_SMP=y

CONFIG_BT_SETTINGS=y

CONFIG_BT_HCI=y
CONFIG_BT_CTLR=y

CONFIG_BT_DEBUG_LOG=y
CONFIG_BT_PERIPHERAL=y
CONFIG_BT_DEVICE_NAME="OTAinfo999"

CONFIG_BT_DEVICE_APPEARANCE=833

CONFIG_MCUMGR=y
CONFIG_NET_BUF=y
CONFIG_ZCBOR=y
CONFIG_MCUMGR_GRP_IMG=y
CONFIG_FLASH=y
CONFIG_IMG_MANAGER=y
```

## src/main.c
```c
#include <zephyr/kernel.h>
#include <zephyr/device.h>
#include <zephyr/drivers/sensor.h>
#include <stdio.h>
#include <zephyr/sys/util.h>
#include <string.h>
#include <hal_02_seeed_studio_xiao_nrf52840_sense.h>
#include <zephyr/bluetooth/bluetooth.h>
#include <zephyr/bluetooth/gatt.h>
#include <zephyr/bluetooth/uuid.h>

int main(void)
{
	otainfo_initialize();
    //* Initialize the BT subsystem */
	int err = 0;
    err = bt_enable(NULL);
    if (err) {
        printk("Bluetooth init failed (err %d)\n", err);
        return;
    }
    printk("Bluetooth initialized\n");
    //* Start advertising */
    bt_le_adv_start(BT_LE_ADV_CONN, NULL, 0, NULL, 0);

}
```

## include/hal_02_seeed_studio_xiao_nrf52840_sense.h
```c
//
/// Copyright (c) 2024 OTAinfo, Inc. USA, All rights are reserved.
//

#include <zephyr/zephyr.h>
#include <zephyr/net/socket.h>
#include <zephyr/net/net_ip.h>
#include <stdio.h>
#include <stdlib.h>
#include <string.h>
#include <zephyr/bluetooth/uuid.h>


#ifndef hal_02_seeed_studio_xiao_nrf52840_sense_H
#define hal_02_seeed_studio_xiao_nrf52840_sense_H

typedef struct {
  char *name;
} BLEConnData;

typedef struct {
  double x_val;
  double y_val;
  double z_val;
}AcclerometerData;

typedef struct{
  double Gx;
  double Gy;
  double Gz;
  int sample_rate_hz;
} GyroscopeData;

void otainfo_initialize();

#endif
```
